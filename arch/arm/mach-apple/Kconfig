## arch/arm/mach-apple/Kconfig
```kconfig
# SPDX-License-Identifier: GPL-2.0-only
menuconfig ARCH_APPLE_S5L
	bool "S5L8940X / S5L8947X Cortex-A9 SoCs"
	depends on ARCH_MULTI_V7
	select ARM_ERRATA_754322
	select ARM_ERRATA_764369 if SMP
	select ARM_ERRATA_775420
	select GENERIC_IRQ_CHIP
	select GPIOLIB
	select PINCTRL
	help
	  Support for 32-bit ARMv7 S5L8940X and S5L8947X SoC platforms
	  based on the ARM Cortex-A9 processor core.

if ARCH_APPLE_S5L

config APPLE_S5L_WDT_CLKEVT
	bool "S5L8947X 24 MHz watchdog clocksource and restart handler"
	default y
	help
	  Uses the S5L8947X hardware watchdog 24 MHz counter at 0x3f103020
	  as a continuous clocksource and sched_clock that runs across WFI,
	  calibrates the Cortex-A9 PMCCNTR delay timer, and registers a
	  platform restart handler.

config APPLE_S5L_WATCHDOG
	bool "S5L8947X /dev/watchdog character device"
	depends on APPLE_S5L_WDT_CLKEVT
	default y
	help
	  Exposes /dev/watchdog (misc minor 130) backed by the S5L8947X
	  hardware watchdog timer at 0x3f103020 so userspace watchdog
	  daemons can supervise system health after boot.

endif
```

## drivers/gpu/drm/apple-sgx/Kconfig
```kconfig
# SPDX-License-Identifier: GPL-2.0-only
config DRM_APPLE_SGX
	tristate "S5L8947X PowerVR SGX543"
	depends on DRM
	depends on ARCH_APPLE_S5L || COMPILE_TEST
	depends on COMMON_CLK && OF
	select DRM_GEM_SHMEM_HELPER
	select DRM_SCHED
	help
	  The GPU of the S5L8947X, a PowerVR SGX543.  Switches it on with
	  the initialisation the stock driver runs, starts the GPU
	  microkernel (from /lib/firmware/s5l8947x/sgx543.fw, which stage2
	  carves from the device's own system image), and offers a render
	  node for test programs and Mesa: GEM buffers in the GPU's address
	  space and renders queued to the microkernel.  Research tools are
	  in debugfs (apple-sgx/).

	  The render node's interface is experimental and will change.

	  If unsure, say N.
```

## drivers/gpu/drm/s5l8947x/Kconfig
```kconfig
# SPDX-License-Identifier: GPL-2.0-only
config DRM_S5L8947X
	tristate "S5L8947X display pipe and HDMI"
	depends on DRM && OF
	depends on ARCH_APPLE_S5L || COMPILE_TEST
	select DRM_KMS_HELPER
	select DRM_GEM_DMA_HELPER
	select DRM_DISPLAY_HELPER
	select HDMI
	select VIDEOMODE_HELPERS
	default ARCH_APPLE_S5L
	help
	  KMS driver for the S5L8947X rgbout display pipe and its HDMI 1.4
	  transmitter. Modes come from the sink's EDID; the HDMI PHY limits
	  them to a 162 MHz pixel clock (1080p60). It also provides the HDMI
	  audio bridge used by the S5L8947X ALSA driver.
```

## drivers/media/platform/apple/Kconfig
```kconfig
# SPDX-License-Identifier: GPL-2.0-only

comment "Apple S5L media platform drivers"

config VIDEO_S5L8947X_M2SC
	tristate "S5L8947X M2 scaler and colour-space converter"
	depends on V4L_MEM2MEM_DRIVERS
	depends on VIDEO_DEV
	depends on ARCH_APPLE_S5L || COMPILE_TEST
	depends on COMMON_CLK && HAS_DMA
	select VIDEOBUF2_DMA_CONTIG
	select V4L2_MEM2MEM_DEV
	help
	  Memory-to-memory scaler of the S5L8947X SoC: scales frames up or
	  down (up to 8x down), converts between YCbCr (NV12, NV16, YUYV)
	  and RGB (XRGB8888, RGB565, ARGB1555) with BT.601 or BT.709
	  matrices. A debugfs self-test runs two jobs on hardware and
	  checks the result.

config VIDEO_S5L8947X_JPEG
	tristate "S5L8947X JPEG decoder"
	depends on V4L_MEM2MEM_DRIVERS
	depends on VIDEO_DEV
	depends on ARCH_APPLE_S5L || COMPILE_TEST
	depends on COMMON_CLK && HAS_DMA
	select VIDEOBUF2_DMA_CONTIG
	select V4L2_MEM2MEM_DEV
	help
	  Baseline JPEG decoder of the S5L8947X SoC. The hardware parses
	  the JPEG headers itself and writes NV12, YUYV or UYVY.
```
